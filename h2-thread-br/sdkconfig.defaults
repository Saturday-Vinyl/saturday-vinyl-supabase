## h2-thread-br/sdkconfig.defaults
```kconfig
# Saturday Vinyl Hub - ESP32-H2 Thread Border Router SDK Configuration
# This is the dedicated Thread co-processor for mesh networking.

# Target: ESP32-H2
CONFIG_IDF_TARGET="esp32h2"

# Project configuration
CONFIG_ESPTOOLPY_MONITOR_BAUD=115200

# Partition table
CONFIG_PARTITION_TABLE_CUSTOM=y
CONFIG_PARTITION_TABLE_CUSTOM_FILENAME="partitions.csv"

# Flash configuration (4MB flash)
CONFIG_ESPTOOLPY_FLASHSIZE_4MB=y
CONFIG_ESPTOOLPY_FLASHMODE_DIO=y
CONFIG_ESPTOOLPY_FLASHFREQ_48M=y

# =============================================================================
# FreeRTOS Configuration
# =============================================================================
CONFIG_FREERTOS_HZ=1000
CONFIG_FREERTOS_TIMER_TASK_STACK_DEPTH=3072

# =============================================================================
# Logging
# =============================================================================
CONFIG_LOG_DEFAULT_LEVEL_INFO=y
CONFIG_LOG_MAXIMUM_LEVEL_DEBUG=y

# =============================================================================
# OpenThread Configuration
# =============================================================================
# Note: ESP32-H2 doesn't have prebuilt BORDER_ROUTER library in ESP-IDF 5.5
# Configure as FTD (Full Thread Device) for mesh networking.
# Border routing (IP bridging) happens at application level via UART to S3.
CONFIG_OPENTHREAD_ENABLED=y
CONFIG_OPENTHREAD_FTD=y
CONFIG_OPENTHREAD_RADIO_NATIVE=y
CONFIG_OPENTHREAD_COMMISSIONER=y

# Thread network settings
CONFIG_OPENTHREAD_DNS_CLIENT=n
CONFIG_OPENTHREAD_SRP_CLIENT=y

# Disable OpenThread CLI - all control via UART from S3
CONFIG_OPENTHREAD_CLI=n
CONFIG_OPENTHREAD_CONSOLE_ENABLE=n

# Thread network defaults (overridden at runtime)
CONFIG_OPENTHREAD_NETWORK_NAME="SaturdayVinyl"
CONFIG_OPENTHREAD_NETWORK_CHANNEL=15
CONFIG_OPENTHREAD_NETWORK_PANID=0x5356

# =============================================================================
# IEEE 802.15.4 Radio (Thread)
# =============================================================================
CONFIG_IEEE802154_ENABLED=y

# =============================================================================
# mbedTLS for Thread (DTLS)
# =============================================================================
CONFIG_MBEDTLS_SSL_PROTO_DTLS=y
CONFIG_MBEDTLS_SSL_DTLS_HELLO_VERIFY=y
CONFIG_MBEDTLS_SSL_DTLS_SRTP=n
CONFIG_MBEDTLS_KEY_EXCHANGE_ECJPAKE=y
CONFIG_MBEDTLS_ECJPAKE_C=y

# =============================================================================
# UART Configuration (Communication with S3)
# =============================================================================
CONFIG_UART_ISR_IN_IRAM=y

# H2 uses UART0 for S3 communication (no USB console)
CONFIG_ESP_CONSOLE_NONE=y

# =============================================================================
# NVS Storage
# =============================================================================
# Store Thread credentials in NVS

# =============================================================================
# Watchdog
# =============================================================================
CONFIG_ESP_TASK_WDT_EN=y
CONFIG_ESP_TASK_WDT_TIMEOUT_S=30

# =============================================================================
# Power Management
# =============================================================================
# Disable PM for reliable Thread operation
CONFIG_PM_ENABLE=n

# =============================================================================
# Bootloader Configuration
# =============================================================================
CONFIG_BOOTLOADER_APP_ROLLBACK_ENABLE=y

# =============================================================================
# System Configuration
# =============================================================================
CONFIG_ESP_SYSTEM_EVENT_TASK_STACK_SIZE=4096
```

## main/Kconfig.projbuild
```kconfig
menu "Saturday Vinyl Hub Configuration"

    config SV_HUB_LOG_LEVEL
        int "Default log level (0=None, 1=Error, 2=Warn, 3=Info, 4=Debug, 5=Verbose)"
        default 3
        range 0 5
        help
            Set the default logging level for Saturday Hub components.

    menu "RFID Configuration"
        config SV_RFID_POLL_INTERVAL_MS
            int "RFID poll interval (ms)"
            default 500
            range 100 5000
            help
                Time between RFID polling attempts in milliseconds.

        config SV_RFID_POWER_DBM
            int "RFID RF power (dBm)"
            default 10
            range 0 30
            help
                RF output power for RFID module in dBm.

        config SV_RFID_DEBOUNCE_PRESENT_MS
            int "Tag present debounce time (ms)"
            default 1000
            range 0 5000
            help
                Time a tag must be present before confirming detection.

        config SV_RFID_DEBOUNCE_ABSENT_MS
            int "Tag absent debounce time (ms)"
            default 2000
            range 0 10000
            help
                Time a tag must be absent before confirming removal.
    endmenu

    menu "LED Configuration"
        config SV_LED_DEFAULT_BRIGHTNESS
            int "Default LED brightness (0-255)"
            default 128
            range 0 255
            help
                Default brightness level for the RGB LED.
    endmenu

endmenu
```

## s3-master/sdkconfig.defaults
```kconfig
# Saturday Vinyl Hub - ESP32-S3 Master SDK Configuration
# This is the master MCU handling WiFi, BLE, RFID, USB, and H2 management.

# Target: ESP32-S3
CONFIG_IDF_TARGET="esp32s3"

# Project configuration
CONFIG_ESPTOOLPY_MONITOR_BAUD=115200

# Partition table
CONFIG_PARTITION_TABLE_CUSTOM=y
CONFIG_PARTITION_TABLE_CUSTOM_FILENAME="partitions.csv"

# Flash configuration (8MB flash for S3 with OTA support)
CONFIG_ESPTOOLPY_FLASHSIZE_8MB=y
CONFIG_ESPTOOLPY_FLASHMODE_DIO=y
CONFIG_ESPTOOLPY_FLASHFREQ_80M=y

# =============================================================================
# Compiler Optimization
# =============================================================================
CONFIG_COMPILER_OPTIMIZATION_SIZE=y

# =============================================================================
# FreeRTOS Configuration
# =============================================================================
CONFIG_FREERTOS_HZ=1000
CONFIG_FREERTOS_TIMER_TASK_STACK_DEPTH=2048

# =============================================================================
# Task Stack Sizes
# =============================================================================
CONFIG_ESP_MAIN_TASK_STACK_SIZE=4096
CONFIG_ESP_IPC_TASK_STACK_SIZE=1024

# =============================================================================
# Logging
# =============================================================================
CONFIG_LOG_DEFAULT_LEVEL_INFO=y
CONFIG_LOG_MAXIMUM_LEVEL_DEBUG=y

# =============================================================================
# Wi-Fi Configuration
# =============================================================================
CONFIG_ESP_WIFI_STATIC_RX_BUFFER_NUM=10
CONFIG_ESP_WIFI_DYNAMIC_RX_BUFFER_NUM=24
CONFIG_ESP_WIFI_TX_BUFFER_TYPE=1
CONFIG_ESP_WIFI_DYNAMIC_TX_BUFFER_NUM=24

# =============================================================================
# Networking (LwIP)
# =============================================================================
CONFIG_LWIP_LOCAL_HOSTNAME="saturday-hub"
CONFIG_LWIP_NETIF_STATUS_CALLBACK=y

# =============================================================================
# HTTP/HTTPS Client
# =============================================================================
CONFIG_ESP_HTTP_CLIENT_ENABLE_HTTPS=y
CONFIG_ESP_HTTP_CLIENT_ENABLE_BASIC_AUTH=y

# =============================================================================
# TLS Certificate Bundle for HTTPS
# =============================================================================
CONFIG_MBEDTLS_CERTIFICATE_BUNDLE=y
CONFIG_MBEDTLS_CERTIFICATE_BUNDLE_DEFAULT_CMN=y
CONFIG_MBEDTLS_ASYMMETRIC_CONTENT_LEN=y
# Reduced from 16384 to 8192 to fit in fragmented heap during BLE adoption.
# Supabase edge functions and PostgREST responses are well under 8KB; OTA
# downloads negotiate down to whatever we advertise. 8KB leaves margin
# above any expected response size.
CONFIG_MBEDTLS_SSL_IN_CONTENT_LEN=8192
CONFIG_MBEDTLS_SSL_OUT_CONTENT_LEN=4096
# Dynamic allocation during handshake; buffers are freed when handshake
# completes. Critical for opening new TLS connections while NimBLE is alive
# (BLE adoption flow opens HTTPS to adopt_device before BLE is freed).
CONFIG_MBEDTLS_DYNAMIC_BUFFER=y
CONFIG_MBEDTLS_DYNAMIC_FREE_CA_CERT=y

# =============================================================================
# Bluetooth (NimBLE for BLE Provisioning)
# =============================================================================
CONFIG_BT_ENABLED=y
CONFIG_BT_NIMBLE_ENABLED=y
CONFIG_BT_NIMBLE_MAX_CONNECTIONS=1
CONFIG_BT_NIMBLE_ROLE_CENTRAL=n
CONFIG_BT_NIMBLE_ROLE_PERIPHERAL=y
CONFIG_BT_NIMBLE_ROLE_BROADCASTER=y
CONFIG_BT_NIMBLE_ROLE_OBSERVER=n
CONFIG_BT_NIMBLE_NVS_PERSIST=y
CONFIG_BT_NIMBLE_SM_LEGACY=y
CONFIG_BT_NIMBLE_SM_SC=y
CONFIG_BT_NIMBLE_SVC_GAP_DEVICE_NAME="Saturday Hub"
CONFIG_BT_NIMBLE_GAP_DEVICE_NAME_MAX_LEN=32

# =============================================================================
# USB Configuration (for Service Mode and esp-serial-flasher)
# =============================================================================
# ESP32-S3 has native USB support
CONFIG_USB_OTG_SUPPORTED=y

# Serial console configuration for bidirectional USB Serial JTAG communication
#
# We use CONFIG_ESP_CONSOLE_NONE for the primary console to prevent the VFS layer
# from taking ownership of USB Serial JTAG stdin. This allows serial_prov.c to use
# usb_serial_jtag_read_bytes() directly for receiving commands.
#
# We use CONFIG_ESP_CONSOLE_SECONDARY_USB_SERIAL_JTAG to route ESP_LOG output
# to USB Serial JTAG. This uses ROM printf functions that write directly to the
# hardware FIFO, which doesn't conflict with our RX driver usage.
#
# This split configuration allows:
# 1. ESP_LOG output via USB Serial JTAG (secondary console)
# 2. usb_serial_jtag_read_bytes() for receiving commands (no VFS conflict)
# 3. usb_serial_jtag_write_bytes() for sending JSON responses
CONFIG_ESP_CONSOLE_NONE=y
CONFIG_ESP_CONSOLE_SECONDARY_USB_SERIAL_JTAG=y

# =============================================================================
# UART Configuration
# =============================================================================
# UART1: RFID Module (YRM100)
# UART2: H2 Communication
CONFIG_UART_ISR_IN_IRAM=y

# =============================================================================
# NVS Storage
# =============================================================================
# NVS encryption (optional, enable for production)
# CONFIG_NVS_ENCRYPTION=y

# =============================================================================
# Watchdog
# =============================================================================
CONFIG_ESP_TASK_WDT_EN=y
CONFIG_ESP_TASK_WDT_TIMEOUT_S=30

# =============================================================================
# Power Management
# =============================================================================
CONFIG_PM_ENABLE=n

# =============================================================================
# VFS Configuration (for non-blocking stdin)
# =============================================================================
CONFIG_VFS_SUPPORT_IO=y
CONFIG_VFS_SUPPORT_SELECT=y

# =============================================================================
# Bootloader Configuration
# =============================================================================
CONFIG_BOOTLOADER_APP_ROLLBACK_ENABLE=y
CONFIG_BOOTLOADER_WDT_ENABLE=y

# =============================================================================
# HTTPS OTA Configuration
# =============================================================================
CONFIG_ESP_HTTPS_OTA_DECRYPT_CB=n
CONFIG_ESP_HTTPS_OTA_ALLOW_HTTP=n

# =============================================================================
# System Event Task Stack (increased for complex operations)
# =============================================================================
CONFIG_ESP_SYSTEM_EVENT_TASK_STACK_SIZE=4096
```

## sdkconfig.defaults
```kconfig
# Saturday Vinyl Hub - SDK Configuration Defaults
# These settings are applied when the project is first configured
# or when sdkconfig is deleted.

# Target: ESP32-C6
CONFIG_IDF_TARGET="esp32c6"

# Project name
CONFIG_ESPTOOLPY_MONITOR_BAUD=115200

# Partition table
CONFIG_PARTITION_TABLE_CUSTOM=y
CONFIG_PARTITION_TABLE_CUSTOM_FILENAME="partitions.csv"

# Flash configuration (4MB flash typical)
CONFIG_ESPTOOLPY_FLASHSIZE_4MB=y
CONFIG_ESPTOOLPY_FLASHMODE_DIO=y
CONFIG_ESPTOOLPY_FLASHFREQ_80M=y

# FreeRTOS configuration
CONFIG_FREERTOS_HZ=1000
CONFIG_FREERTOS_TIMER_TASK_STACK_DEPTH=3072

# Logging
CONFIG_LOG_DEFAULT_LEVEL_INFO=y
CONFIG_LOG_MAXIMUM_LEVEL_DEBUG=y

# Enable heap tracing for debugging (can disable in production)
CONFIG_HEAP_TRACING_OFF=y

# Wi-Fi configuration
CONFIG_ESP_WIFI_STATIC_RX_BUFFER_NUM=10
CONFIG_ESP_WIFI_DYNAMIC_RX_BUFFER_NUM=32
CONFIG_ESP_WIFI_TX_BUFFER_TYPE=1
CONFIG_ESP_WIFI_DYNAMIC_TX_BUFFER_NUM=32

# Networking
CONFIG_LWIP_LOCAL_HOSTNAME="saturday-hub"
CONFIG_LWIP_IPV6_NUM_ADDRESSES=12
CONFIG_LWIP_NETIF_STATUS_CALLBACK=y

# HTTP/HTTPS client (Phase 4)
CONFIG_ESP_HTTP_CLIENT_ENABLE_HTTPS=y
CONFIG_ESP_HTTP_CLIENT_ENABLE_BASIC_AUTH=y

# TLS certificate bundle for HTTPS (Phase 4)
CONFIG_MBEDTLS_CERTIFICATE_BUNDLE=y
CONFIG_MBEDTLS_CERTIFICATE_BUNDLE_DEFAULT_FULL=y

# Bluetooth (for BLE provisioning - Phase 7)
CONFIG_BT_ENABLED=y
CONFIG_BT_NIMBLE_ENABLED=y
CONFIG_BT_NIMBLE_MAX_CONNECTIONS=1
CONFIG_BT_NIMBLE_ROLE_CENTRAL=n
CONFIG_BT_NIMBLE_ROLE_PERIPHERAL=y
CONFIG_BT_NIMBLE_ROLE_BROADCASTER=y
CONFIG_BT_NIMBLE_ROLE_OBSERVER=n
CONFIG_BT_NIMBLE_NVS_PERSIST=y
CONFIG_BT_NIMBLE_SM_LEGACY=y
CONFIG_BT_NIMBLE_SM_SC=y
CONFIG_BT_NIMBLE_SVC_GAP_DEVICE_NAME="Saturday Hub"
CONFIG_BT_NIMBLE_GAP_DEVICE_NAME_MAX_LEN=32

# OpenThread (for Thread Border Router) - Phase 8
CONFIG_OPENTHREAD_ENABLED=y
CONFIG_OPENTHREAD_BORDER_ROUTER=y
CONFIG_OPENTHREAD_RADIO_NATIVE=y

# Thread Border Router specific settings
CONFIG_OPENTHREAD_BR_AUTO_START=n
CONFIG_OPENTHREAD_DNS64_CLIENT=y
CONFIG_OPENTHREAD_SRP_CLIENT=y

# Disable OpenThread CLI - conflicts with serial provisioning on USB Serial JTAG
CONFIG_OPENTHREAD_CLI=n
CONFIG_OPENTHREAD_CONSOLE_ENABLE=n

# Thread network defaults (overridden at runtime)
CONFIG_OPENTHREAD_NETWORK_NAME="SaturdayVinyl"
CONFIG_OPENTHREAD_NETWORK_CHANNEL=15
CONFIG_OPENTHREAD_NETWORK_PANID=0x5356

# mbedTLS configuration for Thread (DTLS) - keep enabled for future use
CONFIG_MBEDTLS_SSL_PROTO_DTLS=y
CONFIG_MBEDTLS_SSL_DTLS_HELLO_VERIFY=y
CONFIG_MBEDTLS_SSL_DTLS_SRTP=n
CONFIG_MBEDTLS_KEY_EXCHANGE_ECJPAKE=y
CONFIG_MBEDTLS_ECJPAKE_C=y

# OpenThread memory settings (requires OpenThread enabled)
# CONFIG_OPENTHREAD_NUM_MESSAGE_BUFFERS=65
# CONFIG_OPENTHREAD_SPINEL_RX_FRAME_BUFFER_SIZE=2048

# IEEE 802.15.4 radio settings for ESP32-C6 - keep enabled for future use
CONFIG_IEEE802154_ENABLED=y

# NVS encryption (optional, enable for production)
# CONFIG_NVS_ENCRYPTION=y

# Watchdog
CONFIG_ESP_TASK_WDT_EN=y
CONFIG_ESP_TASK_WDT_TIMEOUT_S=30

# UART for RFID module
CONFIG_UART_ISR_IN_IRAM=y

# Enable app rollback for OTA safety
CONFIG_BOOTLOADER_APP_ROLLBACK_ENABLE=y

# Power management (disable for now, enable if battery operation needed)
CONFIG_PM_ENABLE=n

# Serial console - Use USB Serial/JTAG for ESP32-C6 DevKitC
# This enables stdin/stdout over the USB connection
CONFIG_ESP_CONSOLE_USB_SERIAL_JTAG=y

# VFS configuration for non-blocking stdin reads
CONFIG_VFS_SUPPORT_IO=y
CONFIG_VFS_SUPPORT_SELECT=y
```
